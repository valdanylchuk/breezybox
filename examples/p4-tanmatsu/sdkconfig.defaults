## examples/p4-tanmatsu/sdkconfig.defaults
```kconfig
#
# BreezyBox / Tanmatsu (ESP32-P4) defaults
# Hardware-specific values mirror the Tanmatsu native launcher so badge-bsp,
# PSRAM and the esp-hosted link to the C6 radio behave identically.
#

# --- Target & flash ---
CONFIG_IDF_TARGET="esp32p4"
CONFIG_ESPTOOLPY_FLASHSIZE_16MB=y
CONFIG_PARTITION_TABLE_CUSTOM=y
CONFIG_PARTITION_TABLE_CUSTOM_FILENAME="partitions.csv"

# --- Board support package (Tanmatsu) ---
CONFIG_BSP_TARGET_TANMATSU=y

# badge-bsp's restart_to_launcher stub clears the appfs magic in the custom
# RTC retain area, so it needs the same reserved-RTC layout as the launcher.
# Enabling CUSTOM_RESERVE_RTC also selects BOOTLOADER_RESERVE_RTC_MEM, which
# exposes bootloader_common_get_rtc_retain_mem() and the rtc_retain_mem_t.custom field.
CONFIG_BOOTLOADER_CUSTOM_RESERVE_RTC=y
CONFIG_BOOTLOADER_CUSTOM_RESERVE_RTC_SIZE=0x10

# --- PSRAM (P4 / Tanmatsu) ---
# IMPORTANT: on the P4 the 200 MHz PSRAM speed is gated behind
# IDF_EXPERIMENTAL_FEATURES. Without it the SPIRAM_SPEED_200M choice is
# silently dropped and Kconfig falls back to SPIRAM_SPEED_20M -- far too slow
# to feed the MIPI-DSI DPI, which then logs "can't fetch data from external
# memory fast enough, underrun happens" and shows garbage. The native launcher
# enables this for the same reason.
CONFIG_IDF_EXPERIMENTAL_FEATURES=y
CONFIG_SPIRAM=y
CONFIG_SPIRAM_SPEED_200M=y
CONFIG_SPIRAM_MALLOC_RESERVE_INTERNAL=65536
CONFIG_SPIRAM_PRE_CONFIGURE_MEMORY_PROTECTION=n

# --- Display robustness (mirror the launcher) ---
# Keep the DSI ISR in IRAM so framebuffer transfers aren't stalled by flash
# cache misses, use QIO flash, and link the Winbond flash driver (the chip on
# the Tanmatsu) to silence the "winbond detected but related driver is not
# linked" warning seen at boot.
CONFIG_LCD_DSI_ISR_IRAM_SAFE=y
CONFIG_ESPTOOLPY_FLASHMODE_QIO=y
CONFIG_SPI_FLASH_SUPPORT_WINBOND_CHIP=y

# --- Console: keep a parallel USB-Serial-JTAG console for logs/debug ---
CONFIG_ESP_CONSOLE_USB_SERIAL_JTAG=y

# --- Terminal geometry: 800x480 / 8x16 Terminus = 100 cols x 30 rows ---
# (Kconfig options added to valdanylchuk/breezy_term; defaults stay 128x37.)
CONFIG_VTERM_COLS=100
CONFIG_VTERM_ROWS=30

# --- ELF loader ---
# Built-in libc + ESP-IDF symbol tables (default on) are correct for the P4,
# so downloaded ELF apps resolve standard symbols out of the box. Enable
# CONFIG_ELF_LOADER_CUSTOMER_SYMBOLS only if you add a P4 customer table
# (see main/all_my_symbols.c).
CONFIG_ELF_LOADER_LOAD_PSRAM=y
CONFIG_ELF_LOADER_CUSTOMER_SYMBOLS

# --- Main/system task headroom ---
CONFIG_ESP_MAIN_TASK_STACK_SIZE=8192
CONFIG_ESP_SYSTEM_EVENT_TASK_STACK_SIZE=6144

#
# ============================================================
#  Phase 2 networking: WiFi radio lives on the C6, reached over
#  esp-hosted (SDIO) + esp_wifi_remote, exactly like the launcher.
#  These let the project link the networking commands now; the
#  radio is only brought up when you call the bring-up sequence.
# ============================================================
#

# esp-hosted SDIO transport to the C6 (Tanmatsu pin map, from the launcher)
CONFIG_ESP_HOSTED_PRIV_SDIO_PIN_CMD_SLOT_1=16
CONFIG_ESP_HOSTED_PRIV_SDIO_PIN_CLK_SLOT_1=17
CONFIG_ESP_HOSTED_PRIV_SDIO_PIN_D0_SLOT_1=18
CONFIG_ESP_HOSTED_PRIV_SDIO_PIN_D1_4BIT_BUS_SLOT_1=19
CONFIG_ESP_HOSTED_PRIV_SDIO_PIN_D2_4BIT_BUS_SLOT_1=20
CONFIG_ESP_HOSTED_PRIV_SDIO_PIN_D3_4BIT_BUS_SLOT_1=21
CONFIG_ESP_HOSTED_SDIO_RESET_SLAVE_USING_CALLBACK=y
CONFIG_ESP_HOSTED_SLAVE_RESET_ONLY_IF_NECESSARY=y
CONFIG_ESP_HOSTED_HOST_RESTART_NO_COMMUNICATION_WITH_SLAVE=n
CONFIG_SLAVE_IDF_TARGET_ESP32C6=y

# HTTP / TLS knobs used by breezybox's eget/httpd commands
CONFIG_ESP_TLS_INSECURE=y
CONFIG_HTTPD_MAX_REQ_HDR_LEN=512
CONFIG_MBEDTLS_EXTERNAL_MEM_ALLOC=y
```

## src/components/breezy_term/Kconfig
```kconfig
menu "Breezy Terminal (vterm)"

    config VTERM_COLS
        int "Terminal columns"
        default 128
        help
            Number of character columns in the virtual terminal grid. This is
            also the cell-buffer row stride. Match it to your display, e.g. 100
            for an 800px-wide panel with an 8px-wide font.

    config VTERM_ROWS
        int "Terminal rows"
        default 37
        help
            Number of character rows in the virtual terminal grid. Match it to
            your display, e.g. 30 for a 480px-tall panel with a 16px-tall font.

endmenu
```
